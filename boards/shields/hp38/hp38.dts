left_encoder: encoder1 {
    compatible = "alps,ec11";
    a-gpios = <&pro_micro 2 (GPIO_ACTIVE_HIGH | GPIO_PULL_UP)>;
    b-gpios = <&pro_micro 3 (GPIO_ACTIVE_HIGH | GPIO_PULL_UP)>;
    steps = <80>;
    status = "disabled";
};

sensors: sensors {
    compatible = "zmk,keymap-sensors";
    sensors = <&encoder1>;
    triggers-per-rotation = <20>;
};